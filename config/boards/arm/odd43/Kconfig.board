## config/boards/arm/odd43/Kconfig.board
```kconfig
  
# Copyright (c) 2020 The ZMK Contributors
# SPDX-License-Identifier: MIT

config BOARD_ODD43
   bool "Odd43"
   depends on SOC_NRF52840_QIAA
```

## config/boards/arm/odd43/Kconfig.defconfig
```kconfig
# Copyright (c) 2020 Pete Johanson
# SPDX-License-Identifier: MIT

if BOARD_ODD43

config BOARD
	default "odd43"

config ZMK_KEYBOARD_NAME
	default "odd43" 
	
if USB

config USB_NRFX
	default y

config USB_DEVICE_STACK
	default y

endif # USB

config BT_CTLR
	default BT

config ZMK_BLE
	default y

config ZMK_USB
	default y

config ZMK_BATTERY_VOLTAGE_DIVIDER
	default y

endif # BOARD_ODD43
```
